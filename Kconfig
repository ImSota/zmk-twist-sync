## Kconfig
```kconfig
config ZMK_FEATURE_TWISTSYNC
    bool "Twist synchronization input processor"
    default y
    depends on DT_HAS_ZMK_FEATURE_TWISTSYNC_ENABLED
```

## dts/bindings/input/zmk,feature-twistsync.yaml
```yaml
description: Twist synchronization input processor
compatible: "zmk,feature-twistsync"

include: [ip_two_param.yaml]

properties:
  # "#input-processor-cells":
  #   type: int
  #   const: 2
  param1:
    type: int
  param2:
    type: int
  sensor-right:
    type: phandle
  sensor-bottom:
    type: phandle
```
